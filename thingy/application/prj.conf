## CMakeLists.txt
```
cmake_minimum_required(VERSION 3.20.0)

#set(CMAKE_CXX_STANDARD 11)
#set(CMAKE_CXX_STANDARD_REQUIRED ON)

find_package(Zephyr REQUIRED HINTS $ENV{ZEPHYR_BASE})
project(vibration_sensor)

add_definitions(-DEIDSP_USE_CMSIS_DSP=1
                -DEI_CLASSIFIER_TFLITE_ENABLE_CMSIS_NN=1
                -DARM_MATH_LOOPUNROLL
                )

include(edge-impulse-sdk/cmake/utils.cmake)
add_subdirectory(edge-impulse-sdk/cmake/zephyr)

set(INCLUDES
    .
    include
    tflite-model
    model-parameters
    )
include_directories(${INCLUDES})

RECURSIVE_FIND_FILE(C_SOURCE_FILES "src" "*.c")
RECURSIVE_FIND_FILE(CPP_SOURCE_FILES "src" "*.cpp")
RECURSIVE_FIND_FILE(MODEL_FILES "tflite-model" "*.cpp")
list(APPEND SOURCE_FILES ${C_SOURCE_FILES} ${CPP_SOURCE_FILES} ${MODEL_FILES})

target_sources(app PRIVATE ${SOURCE_FILES})
target_sources(app PRIVATE src/main.cpp)
```

## prj.conf
```kconfig
CONFIG_MAIN_STACK_SIZE=8192
CONFIG_HEAP_MEM_POOL_SIZE=2048

CONFIG_FPU=y

CONFIG_CPLUSPLUS=y
CONFIG_LIB_CPLUSPLUS=y

CONFIG_NEWLIB_LIBC=y
CONFIG_NEWLIB_LIBC_FLOAT_PRINTF=y

CONFIG_PWM=y

CONFIG_SENSOR=y

CONFIG_ADXL362=y
CONFIG_ADXL362_ACCEL_RANGE_4G=y
CONFIG_ADXL362_ACCEL_ODR_400=y

CONFIG_ADXL372=y
CONFIG_ADXL372_SPI=y
CONFIG_ADXL372_MEASUREMENT_MODE=y
CONFIG_ADXL372_LPF_DISABLE=y
CONFIG_ADXL372_HPF_DISABLE=y
CONFIG_ADXL372_REFERENCED_ACTIVITY_DETECTION_MODE=n
CONFIG_ADXL372_ODR_6400HZ=y

CONFIG_TIMING_FUNCTIONS=y

CONFIG_NETWORKING=y
CONFIG_NET_NATIVE=n
CONFIG_NET_SOCKETS_OFFLOAD=y
CONFIG_NET_SOCKETS=y
CONFIG_NET_SOCKETS_POSIX_NAMES=y

CONFIG_LTE_LINK_CONTROL=y
CONFIG_LTE_AUTO_INIT_AND_CONNECT=n

CONFIG_NRF_MODEM_LIB=y

CONFIG_MQTT_LIB=y
CONFIG_MQTT_LIB_TLS=n
CONFIG_MQTT_CLEAN_SESSION=y
```

## thingy91_nrf9160_ns.overlay
```dts
#include <dt-bindings/pwm/pwm.h>

/ {};

&uart0 {
    current-speed = <921600>;
};
```

## src/main.c
```c
#include <zephyr.h>
#include <stdio.h>
#include "../include/leds.h"
#include "../include/accels.h"
#include "../include/pca.h"

#define PRINT_MAGNITUDES
//#define PRINT_PCA

#ifdef PRINT_MAGNITUDES
void printMag(const float *buf)
{
	leds_setTransmitting(true);
	for (uint16_t k = 0; k < ACCEL_NUM_MAGNITUDES; k++)
	{
		if (k < ACCEL_NUM_MAGNITUDES - 1)
			printf("%.3f, ", buf[k]);
		else
			printf("%.3f", buf[k]);
		k_sleep(K_USEC(10));
	}
	printf("\n");
	leds_setTransmitting(false);
}
#endif

#ifdef PRINT_PCA
void printPCA(const float *buf)
{
	leds_setTransmitting(true);
	for (uint16_t k = 0; k < PCA_RESULT_SIZE; k++)
	{
		if (k < PCA_RESULT_SIZE - 1)
			printf("%.3f, ", buf[k]);
		else
			printf("%.3f", buf[k]);
		k_sleep(K_USEC(10));
	}
	printf("\n");
	leds_setTransmitting(false);
}
#endif

void main(void)
{
	// Disable buffering.
	setvbuf(stdout, NULL, _IONBF, 0);

	k_sleep(K_MSEC(2000));

	if (!leds_init())
		return;

	leds_setState(OKAY);

	if (!accels_init())
		return;

	while (true)
	{

		if (!accels_sample())
			return;

#ifdef PRINT_MAGNITUDES
		printf("---\n");
		for (uint8_t i = 0; i < ACCEL_NUM_AXES; i++)
			printMag(accels_getVelocityMagnitudes(ACCEL_HIGH_G, i));
#endif

		/*float *mags[PCA_NUM_INPUT_BUFS] = {accels_getVelocityMagnitudes(ACCEL_HIGH_G, ACCEL_X_IDX),
										   accels_getVelocityMagnitudes(ACCEL_HIGH_G, ACCEL_Y_IDX),
										   accels_getVelocityMagnitudes(ACCEL_HIGH_G, ACCEL_Z_IDX)};*/

		//pca(mags);

#ifdef PRINT_PCA
		//printf("---\n");
		//printPCA(pca_getResultBuf());
#endif
	}
}
```

## include/accels.h
```c
#pragma once

#ifdef __cplusplus
extern "C" {
#endif

#include <stdint.h>
#include <stdbool.h>

#define ACCEL_TOTAL_SAMPLES_PER_ACCEL_CHANNEL 256                           // MUST BE POWER OF 2!
#define ACCEL_WINDOW_SHIFT_IN_SAMPLES ACCEL_TOTAL_SAMPLES_PER_ACCEL_CHANNEL // Must be less or equal to ACCEL_TOTAL_SAMPLES_PER_ACCEL_CHANNEL.
#define ACCEL_DELAY_BETWEEN_SAMPLES_US 400

#define ACCEL_DELTA_T (ACCEL_DELAY_BETWEEN_SAMPLES_US / (float)1000000)
#define ACCEL_NUM_MAGNITUDES (ACCEL_TOTAL_SAMPLES_PER_ACCEL_CHANNEL / 2 + 1)

#define ACCEL_SAMPLING_FREQ (1 / ACCEL_DELTA_T)
#define ACCEL_MAG_FREQ_START 0
#define ACCEL_MAG_FREQ_STEP (ACCEL_SAMPLING_FREQ / (float)ACCEL_TOTAL_SAMPLES_PER_ACCEL_CHANNEL)
#define ACCEL_MAG_FREQ_END ((ACCEL_NUM_MAGNITUDES - 1) * ACCEL_MAG_FREQ_STEP)

#define ACCEL_NUM_AXES 3
#define ACCEL_X_IDX 0
#define ACCEL_Y_IDX 1
#define ACCEL_Z_IDX 2

enum AccelType
{
    ACCEL_LOW_POWER = 0,
    ACCEL_HIGH_G
};

bool accels_init();
bool accels_sample();
float *accels_getVelocityMagnitudes(enum AccelType accel, uint8_t idx);

#ifdef __cplusplus
}
#endif
```

## include/inference.hpp
```c
#pragma once

#include "pca.h"

#define INFERENCE_WINDOW_SIZE 10

enum Classification
{
    BEARING = 0,
    RUNNING,
    STOPPED,
    THROTTLE,
    NOT_SURE
};

enum Classification inference(float buf[PCA_RESULT_SIZE]);
```

## include/led_alerts.h
```c
#pragma once

#include <stdbool.h>

enum Alert {
    OKAY = 0,
    WARNING,
    CRITICAL
};

bool alerts_init();
void alerts_set(enum Alert a);
void alerts_transmitting(bool t);
```

## include/leds.h
```c
#pragma once

#ifdef __cplusplus
extern "C" {
#endif

#include <stdbool.h>

enum VisualAlert {
    OKAY = 0,
    WARNING,
    CRITICAL
};

bool leds_init();
void leds_setState(enum VisualAlert a);
void leds_setTransmitting(bool t);

#ifdef __cplusplus
}
#endif
```

## include/mqtt.h
```c
#pragma once

#include "inference.hpp"

#ifdef __cplusplus
extern "C"
{
#endif

#define MQTT_BUFFER_SIZE 512
#define MQTT_PUB_TOPIC "sample_motor/maintenance"
#define MQTT_CLIENT_ID "sample_motor_cbs"
#define MQTT_BROKER_HOSTNAME "mqtt.eclipseprojects.io"
#define MQTT_BROKER_PORT 1883
#define MQTT_FAULT_WAIT_TIME_SECONDS 600

    void mqtt_setClassification(enum Classification c);

#ifdef __cplusplus
}
#endif
```

## include/pca.h
```c
#pragma once

#ifdef __cplusplus
extern "C" {
#endif

#define PCA_RESULT_SIZE 70

#define PCA_ROWS 387
#define PCA_COLS PCA_RESULT_SIZE

#define PCA_NUM_INPUT_BUFS 3
#define PCA_SINGLE_BUF_SIZE (PCA_ROWS / PCA_NUM_INPUT_BUFS)

void pca(float *bufs[PCA_NUM_INPUT_BUFS]);
float *pca_getResultBuf();

#ifdef __cplusplus
}
#endif
```

## include/sensors.h
```c
#pragma once

#include <stdint.h>
#include <stdbool.h>

#define TOTAL_SAMPLES_PER_ACCEL_CHANNEL 16 // MUST BE POWER OF 2!
#define WINDOW_SHIFT_IN_SAMPLES 16         // Must be less or equal to TOTAL_SAMPLES_PER_ACCEL_CHANNEL.
#define DELAY_BETWEEN_SAMPLES_US 1000

#define SAMPLING_FREQ (1 / (DELAY_BETWEEN_SAMPLES_US / (float)1000000))
#define NUM_MAGNITUDES (TOTAL_SAMPLES_PER_ACCEL_CHANNEL / 2 + 1)
#define MAG_FREQ_START 0
#define MAG_FREQ_STEP (SAMPLING_FREQ / (float)TOTAL_SAMPLES_PER_ACCEL_CHANNEL)
#define MAG_FREQ_END ((NUM_MAGNITUDES - 1) * MAG_FREQ_STEP)

#define X_IDX 0
#define Y_IDX 1
#define Z_IDX 2

enum AccelType
{
    LOW_POWER = 0,
    HIGH_G
};

bool sensors_init();
bool sensors_sample();
const float *sensors_getMagnitudes(enum AccelType accel, uint8_t idx);
```

## include/sig.h
```c
#pragma once

#ifdef __cplusplus
extern "C" {
#endif

#include "accels.h"

#define SIG_LOW_PASS_CUTOFF_FREQ 240
#define SIG_HIGH_PASS_CUTOFF_FREQ 100
#define SIG_RSS_WINDOW_LENGTH 16

void sig_init();

void sig_center(float signal[ACCEL_TOTAL_SAMPLES_PER_ACCEL_CHANNEL]);
void sig_lowPassFilter(float signal[ACCEL_TOTAL_SAMPLES_PER_ACCEL_CHANNEL]);
void sig_highPassFilter(float signal[ACCEL_TOTAL_SAMPLES_PER_ACCEL_CHANNEL]);
void sig_integrate(float signal[ACCEL_TOTAL_SAMPLES_PER_ACCEL_CHANNEL]);
void sig_hamming(float signal[ACCEL_TOTAL_SAMPLES_PER_ACCEL_CHANNEL]);
void sig_fftMagnitude(float signal[ACCEL_TOTAL_SAMPLES_PER_ACCEL_CHANNEL]);
void sig_RSS(float magnitudes[ACCEL_NUM_MAGNITUDES]);

#ifdef __cplusplus
}
#endif
```

## src/accels.c
```c
#include "accels.h"
#include "sig.h"

#include <stdio.h>
#include <device.h>
#include <drivers/sensor.h>
#include <math.h>
#include <timing/timing.h>

bool accles_init();
bool accles_sample();
float *accels_getVelocityMagnitudes(enum AccelType accel, uint8_t idx);

// static float accels_lowPowerAccelSamples[ACCEL_NUM_AXES][ACCEL_TOTAL_SAMPLES_PER_ACCEL_CHANNEL];
static float accels_highGAccelSamples[ACCEL_NUM_AXES][ACCEL_TOTAL_SAMPLES_PER_ACCEL_CHANNEL];

static const struct device *lowPowerAccel = DEVICE_DT_GET_ANY(adi_adxl362);
static const struct device *highGAccel = DEVICE_DT_GET_ANY(adi_adxl372);

static void shiftSamples();
static bool fetchSingleAccel(const struct device *accel, float buf[ACCEL_NUM_AXES][ACCEL_TOTAL_SAMPLES_PER_ACCEL_CHANNEL], uint8_t sample_idx, const char *name);

bool accels_init()
{
    if (!device_is_ready(lowPowerAccel))
    {
        printf("GET ADXL362 failed!\n");
        return false;
    }

    if (!device_is_ready(highGAccel))
    {
        printf("GET ADXL372 failed!\n");
        return false;
    }

    sig_init();

    return true;
}

bool accels_sample()
{
    timing_t startTime, endTime372;
    uint64_t totalCycles372;
    uint64_t totalNs372;
    int64_t remainingTimeUs;

    shiftSamples();

    for (uint16_t i = ACCEL_TOTAL_SAMPLES_PER_ACCEL_CHANNEL - ACCEL_WINDOW_SHIFT_IN_SAMPLES; i < ACCEL_TOTAL_SAMPLES_PER_ACCEL_CHANNEL; i++)
    {
        timing_init();
        timing_start();

        startTime = timing_counter_get();

        /*if (!fetchSingleAccel(lowPowerAccel, accels_lowPowerAccelSamples, i, "ADXL362"))
            return false;*/

        if (!fetchSingleAccel(highGAccel, accels_highGAccelSamples, i, "ADXL372"))
            return false;

        endTime372 = timing_counter_get();

        timing_stop();

        totalCycles372 = timing_cycles_get(&startTime, &endTime372);
        totalNs372 = timing_cycles_to_ns(totalCycles372);

        remainingTimeUs = ACCEL_DELAY_BETWEEN_SAMPLES_US - totalNs372 / 1000;

        if (remainingTimeUs > 0)
            k_sleep(K_USEC(remainingTimeUs));
    }

    for (uint8_t i = 0; i < ACCEL_NUM_AXES; i++)
    {
        /*sig_lowPassFilter(accels_lowPowerAccelSamples[i]);
        sig_highPassFilter(accels_lowPowerAccelSamples[i]);
        sig_integrate(accels_lowPowerAccelSamples[i]);
        sig_center(accels_lowPowerAccelSamples[i]);
        sig_hamming(accels_highGAccelSamples[i]);
        sig_fftMagnitude(accels_lowPowerAccelSamples[i]);
        sig_RSS(accels_lowPowerAccelSamples[i]);*/

        //sig_lowPassFilter(accels_highGAccelSamples[i]);
        sig_highPassFilter(accels_highGAccelSamples[i]);
        sig_integrate(accels_highGAccelSamples[i]);
        sig_center(accels_highGAccelSamples[i]);
        sig_hamming(accels_highGAccelSamples[i]);
        sig_fftMagnitude(accels_highGAccelSamples[i]);
        sig_RSS(accels_highGAccelSamples[i]);
    }

    return true;
}

float *accels_getVelocityMagnitudes(enum AccelType accel, uint8_t idx)
{
    /*if (accel == ACCEL_LOW_POWER)
        return accels_lowPowerAccelSamples[idx];*/

    if (accel == ACCEL_HIGH_G)
        return accels_highGAccelSamples[idx];

    return NULL;
}

static void shiftSamples()
{
    for (uint8_t i = 0; i < ACCEL_NUM_AXES; i++)
    {
        for (uint16_t j = ACCEL_WINDOW_SHIFT_IN_SAMPLES; j < ACCEL_TOTAL_SAMPLES_PER_ACCEL_CHANNEL; j++)
        {
            // accels_lowPowerAccelSamples[i][j - ACCEL_WINDOW_SHIFT_IN_SAMPLES] = accels_lowPowerAccelSamples[i][j];
            accels_highGAccelSamples[i][j - ACCEL_WINDOW_SHIFT_IN_SAMPLES] = accels_highGAccelSamples[i][j];
        }
    }
}

static bool fetchSingleAccel(const struct device *accel, float buf[ACCEL_NUM_AXES][ACCEL_TOTAL_SAMPLES_PER_ACCEL_CHANNEL], uint8_t sample_idx, const char *name)
{
    struct sensor_value vals[3];

    if (sensor_sample_fetch(accel) < 0)
    {
        printf("%s fetch error!\n", name);
        return false;
    }

    if (sensor_channel_get(accel, SENSOR_CHAN_ACCEL_X, &vals[ACCEL_X_IDX]) < 0)
    {
        printf("%s's X get error\n", name);
        return false;
    }

    if (sensor_channel_get(accel, SENSOR_CHAN_ACCEL_Y, &vals[ACCEL_Y_IDX]) < 0)
    {
        printf("%s's Y get error\n", name);
        return false;
    }

    if (sensor_channel_get(accel, SENSOR_CHAN_ACCEL_Z, &vals[ACCEL_Z_IDX]) < 0)
    {
        printf("%s's Z get error\n", name);
        return false;
    }

    buf[ACCEL_X_IDX][sample_idx] = fabs(sensor_value_to_double(&vals[ACCEL_X_IDX]));
    buf[ACCEL_Y_IDX][sample_idx] = fabs(sensor_value_to_double(&vals[ACCEL_Y_IDX]));
    buf[ACCEL_Z_IDX][sample_idx] = fabs(sensor_value_to_double(&vals[ACCEL_Z_IDX]));

    return true;
}
```

## src/inference.cpp
```c
#include "inference.hpp"
#include "edge-impulse-sdk/classifier/ei_run_classifier.h"
#include "edge-impulse-sdk/dsp/numpy.hpp"

Classification inference(float buf[PCA_RESULT_SIZE]);

static signal_t featureSig;
static uint8_t lastBuf = 0;
static float bufs[INFERENCE_WINDOW_SIZE][PCA_RESULT_SIZE];
static ei_impulse_result_t classificationResult = {0};

static int loadData(size_t offset, size_t length, float *out_ptr);

Classification inference(float buf[PCA_RESULT_SIZE])
{
    for (uint16_t i = 0; i < PCA_RESULT_SIZE; i++)
        bufs[lastBuf][i] = buf[i];

    featureSig.total_length = PCA_RESULT_SIZE * INFERENCE_WINDOW_SIZE;
    featureSig.get_data = &loadData;

    run_classifier(&featureSig, &classificationResult);

    lastBuf++;
    if (lastBuf >= INFERENCE_WINDOW_SIZE)
        lastBuf -= INFERENCE_WINDOW_SIZE;

    if (classificationResult.classification[BEARING].value > 0.8)
        return BEARING;

    if (classificationResult.classification[RUNNING].value > 0.8)
        return RUNNING;

    if (classificationResult.classification[STOPPED].value > 0.8)
        return STOPPED;

    if (classificationResult.classification[THROTTLE].value > 0.8)
        return THROTTLE;

    return NOT_SURE;
}

static int loadData(size_t offset, size_t length, float *out_ptr)
{
    uint8_t firstBuf = lastBuf;

    for (size_t i = 0; i < length; i++)
    {
        uint8_t currBuf = firstBuf + offset / PCA_RESULT_SIZE + i / PCA_RESULT_SIZE;

        if (currBuf >= INFERENCE_WINDOW_SIZE)
            currBuf -= INFERENCE_WINDOW_SIZE;

        out_ptr[i] = bufs[currBuf][i % PCA_RESULT_SIZE];
    }

    /*for(uint8_t currBuf = lastBuf; currBuf < lastBuf + INFERENCE_AVG_WINDOW_SIZE; currBuf++){
        uint8_t currBufFixed = currBuf;
        if (currBufFixed >= INFERENCE_AVG_WINDOW_SIZE)
            currBufFixed -= INFERENCE_AVG_WINDOW_SIZE;

        //size_t off =

        //memcpy(out_ptr, bufs[currBuf] + bufOffset, length * sizeof(float));
    }*/

    return 0;
}
```

## src/led_alerts.c
```c
#include "../include/led_alerts.h"
#include <device.h>
#include <zephyr.h>
#include <drivers/pwm.h>
#include <stdio.h>

bool alerts_init();
void alerts_set(enum Alert a);
void alerts_transmitting(bool t);

#define RED 0
#define GREEN 1
#define BLUE 2

#define RED_GPIO 29
#define GREEN_GPIO 30
#define BLUE_GPIO 31

#define THREAD_WAIT_TIME 50

#define PWM_NODE DT_ALIAS(rgb_pwm)
#define PWM_CTRL PWM_NODE
#define PWM_FLAGS DT_PWMS_FLAGS(PWM_NODE)

static const struct device *pwm = DEVICE_DT_GET(PWM_CTRL);
static struct k_mutex mtx;
static enum Alert currAlert = WARNING;
static bool transmitting = false;

bool alerts_init()
{
    if (!device_is_ready(pwm))
    {
        printf("GET PWM failed!\n");
        return false;
    }
    k_mutex_init(&mtx);
    return true;
}

void alerts_set(enum Alert a)
{
    k_mutex_lock(&mtx, K_FOREVER);
    currAlert = a;
    k_mutex_unlock(&mtx);
}

void alerts_transmitting(bool t)
{
    k_mutex_lock(&mtx, K_FOREVER);
    transmitting = t;
    k_mutex_unlock(&mtx);
}

void alerts_update()
{
    static uint8_t yellow_toggler = 0;
    static uint8_t red_toggler = 0;
    static uint8_t blue_toggler = false;

    uint8_t pulses[3];

    while (true)
    {
        k_mutex_lock(&mtx, K_FOREVER);

        switch (currAlert)
        {
        case OKAY:
            pulses[RED] = 0;
            pulses[GREEN] = 100;
            break;
        case WARNING:
            pulses[RED] = yellow_toggler < 12 ? 100 : 0;
            pulses[GREEN] = yellow_toggler < 12 ? 50 : 0;
            break;
        case CRITICAL:
            pulses[RED] = red_toggler < 4 ? 100 : 0;
            pulses[GREEN] = 0;
            break;
        default:
            pulses[RED] = 0;
            pulses[GREEN] = 0;
            break;
        }

        pulses[BLUE] = transmitting && blue_toggler < 2 ? 100 : 0;
        k_mutex_unlock(&mtx);

        pwm_pin_set_usec(pwm, RED_GPIO, 100, pulses[RED], PWM_FLAGS);
        pwm_pin_set_usec(pwm, GREEN_GPIO, 100, pulses[GREEN], PWM_FLAGS);
        pwm_pin_set_usec(pwm, BLUE_GPIO, 100, pulses[BLUE], PWM_FLAGS);

        yellow_toggler++;
        if (yellow_toggler >= 16)
            yellow_toggler = 0;

        red_toggler++;
        if (red_toggler >= 8)
            red_toggler = 0;

        blue_toggler++;
        if (blue_toggler >= 4)
            blue_toggler = 0;

        k_sleep(K_MSEC(THREAD_WAIT_TIME));
    }
}

K_THREAD_DEFINE(alerts_thread, 256, alerts_update, NULL, NULL, NULL, 0, 0, 0);
```

## src/leds.c
```c
#include "leds.h"
#include <device.h>
#include <zephyr.h>
#include <drivers/pwm.h>
#include <stdio.h>

bool leds_init();
void leds_setState(enum VisualAlert a);
void leds_setTransmitting(bool t);

#define RED 0
#define GREEN 1
#define BLUE 2

#define RED_GPIO 29
#define GREEN_GPIO 30
#define BLUE_GPIO 31

#define THREAD_WAIT_TIME 50

#define PWM_NODE DT_ALIAS(rgb_pwm)
#define PWM_CTRL PWM_NODE
#define PWM_FLAGS DT_PWMS_FLAGS(PWM_NODE)

static const struct device *pwm = DEVICE_DT_GET(PWM_CTRL);
static struct k_mutex mtx;
static enum VisualAlert currAlert = WARNING;
static bool transmitting = false;

static void updateLeds();

bool leds_init()
{
    if (!device_is_ready(pwm))
    {
        printf("GET PWM failed!\n");
        return false;
    }
    k_mutex_init(&mtx);
    return true;
}

void leds_setState(enum VisualAlert a)
{
    k_mutex_lock(&mtx, K_FOREVER);
    currAlert = a;
    k_mutex_unlock(&mtx);
}

void leds_setTransmitting(bool t)
{
    k_mutex_lock(&mtx, K_FOREVER);
    transmitting = t;
    k_mutex_unlock(&mtx);
}

void updateLeds()
{
    static uint8_t yellow_toggler = 0;
    static uint8_t red_toggler = 0;
    static uint8_t blue_toggler = false;

    uint8_t pulses[3];

    while (true)
    {
        k_mutex_lock(&mtx, K_FOREVER);

        switch (currAlert)
        {
        case OKAY:
            pulses[RED] = 0;
            pulses[GREEN] = 100;
            break;
        case WARNING:
            pulses[RED] = yellow_toggler < 12 ? 100 : 0;
            pulses[GREEN] = yellow_toggler < 12 ? 50 : 0;
            break;
        case CRITICAL:
            pulses[RED] = red_toggler < 4 ? 100 : 0;
            pulses[GREEN] = 0;
            break;
        default:
            pulses[RED] = 0;
            pulses[GREEN] = 0;
            break;
        }

        pulses[BLUE] = transmitting && blue_toggler < 2 ? 100 : 0;
        k_mutex_unlock(&mtx);

        pwm_pin_set_usec(pwm, RED_GPIO, 100, pulses[RED], PWM_FLAGS);
        pwm_pin_set_usec(pwm, GREEN_GPIO, 100, pulses[GREEN], PWM_FLAGS);
        pwm_pin_set_usec(pwm, BLUE_GPIO, 100, pulses[BLUE], PWM_FLAGS);

        yellow_toggler++;
        if (yellow_toggler >= 16)
            yellow_toggler = 0;

        red_toggler++;
        if (red_toggler >= 8)
            red_toggler = 0;

        blue_toggler++;
        if (blue_toggler >= 4)
            blue_toggler = 0;

        k_sleep(K_MSEC(THREAD_WAIT_TIME));
    }
}

K_THREAD_DEFINE(leds_thread, 256, updateLeds, NULL, NULL, NULL, 0, 0, 0);
```
